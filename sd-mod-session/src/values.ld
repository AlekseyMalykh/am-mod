SECTIONS { . = 0x06d3b800; .text : { *(.text) } /DISCARD/ : { *(.note*) *(.comment*) *(.eh_frame*) } }
slider_vptr = 0x0706e5d0;
sample_vptr = 0x06e212a0;
knob_fx_vptr = 0x06e1e258;
focus_pointer = 0x0723cde0;
stock_paint_continue = 0x015cd788;
slider_value = 0x011234b0;
component_enabled = 0x010f98d0;
find_colour = 0x01131fa0;
graphics_colour = 0x0102d5e0;
graphics_font = 0x0102dca0;
font_create = 0x01082810;
font_destroy = 0x01070d60;
draw_fitted_text = 0x010817b0;
image_width = 0x01033520;
image_height = 0x01033540;
draw_image_at = 0x01030c30;
fill_rect = 0x0102e000;
string_destroy = 0x00f0a290;
slider_range = 0x01123460;
label_vptr = 0x0706ebf8;
label_text = 0x011bae00;
stock_label_continue = 0x015cf408;
disabled_label_colour = 0x071ec180;

string_copy = 0x00f1c640;
string_utf8 = 0x00f535c0;
font_text_width = 0x0107c6f0;
stock_bounds_continue = 0x01160fc8;
stock_indicator_continue = 0x03b7a718;
ui_screen_0_delta = 0x6e1bf30 - (values_screen_offsets + 0);
ui_screen_1_delta = 0x6e1c3d0 - (values_screen_offsets + 8);
ui_screen_2_delta = 0x6e1c6c8 - (values_screen_offsets + 16);
ui_screen_3_delta = 0x6e1cab8 - (values_screen_offsets + 24);
ui_screen_4_delta = 0x6e1cfb8 - (values_screen_offsets + 32);
ui_screen_5_delta = 0x6e1d3f0 - (values_screen_offsets + 40);
ui_screen_6_delta = 0x6e1d890 - (values_screen_offsets + 48);
ui_screen_7_delta = 0x6e1dd80 - (values_screen_offsets + 56);
ui_screen_8_delta = 0x6e1e258 - (values_screen_offsets + 64);
ui_screen_9_delta = 0x6e1e4d0 - (values_screen_offsets + 72);
ui_screen_10_delta = 0x6e1e9e8 - (values_screen_offsets + 80);
ui_screen_11_delta = 0x6e1f060 - (values_screen_offsets + 88);
ui_screen_12_delta = 0x6e1f400 - (values_screen_offsets + 96);
ui_screen_13_delta = 0x6e1f788 - (values_screen_offsets + 104);
ui_screen_14_delta = 0x6e1faa0 - (values_screen_offsets + 112);
ui_screen_15_delta = 0x6e1fe48 - (values_screen_offsets + 120);
ui_screen_16_delta = 0x6e20070 - (values_screen_offsets + 128);
ui_screen_17_delta = 0x6e20258 - (values_screen_offsets + 136);
ui_screen_18_delta = 0x6e212a0 - (values_screen_offsets + 144);
ui_screen_19_delta = 0x6e22970 - (values_screen_offsets + 152);
ui_screen_20_delta = 0x6e22e18 - (values_screen_offsets + 160);
ui_screen_21_delta = 0x6e23e38 - (values_screen_offsets + 168);
ui_screen_22_delta = 0x6e24618 - (values_screen_offsets + 176);
ui_screen_23_delta = 0x6e24a00 - (values_screen_offsets + 184);
ui_screen_24_delta = 0x6e24f38 - (values_screen_offsets + 192);
ui_screen_25_delta = 0x6e25470 - (values_screen_offsets + 200);
ui_pair_0_delta = 0x6e212a0 - (ui_shift_pairs + 0);
ui_pair_1_delta = 0x6e212a0 - (ui_shift_pairs + 24);
ui_pair_2_delta = 0x6e212a0 - (ui_shift_pairs + 48);
ui_pair_3_delta = 0x6e212a0 - (ui_shift_pairs + 72);
ui_pair_4_delta = 0x6e212a0 - (ui_shift_pairs + 96);
ui_pair_5_delta = 0x6e212a0 - (ui_shift_pairs + 120);
ui_pair_6_delta = 0x6e1bf30 - (ui_shift_pairs + 144);
ui_pair_7_delta = 0x6e23e38 - (ui_shift_pairs + 168);
ui_pair_8_delta = 0x6e23e38 - (ui_shift_pairs + 192);
ui_pair_9_delta = 0x6e24f38 - (ui_shift_pairs + 216);
ui_pair_10_delta = 0x6e1d890 - (ui_shift_pairs + 240);
ui_pair_11_delta = 0x6e1d890 - (ui_shift_pairs + 264);
ui_pair_12_delta = 0x6e1d890 - (ui_shift_pairs + 288);
ui_pair_13_delta = 0x6e1dd80 - (ui_shift_pairs + 312);
ui_pair_14_delta = 0x6e1dd80 - (ui_shift_pairs + 336);
ui_pair_15_delta = 0x6e1dd80 - (ui_shift_pairs + 360);
ui_pair_16_delta = 0x6e1e258 - (ui_shift_pairs + 384);
ui_pair_17_delta = 0x6e1e258 - (ui_shift_pairs + 408);
ui_pair_18_delta = 0x6e1e258 - (ui_shift_pairs + 432);
