SECTIONS { . = 0x06d3b400; .text : { *(.text) } /DISCARD/ : { *(.note*) *(.comment*) *(.eh_frame*) } }
list_append = 0x03b71a60;
string_utf8 = 0x00f535c0;
string_assign = 0x00f1c6f0;
string_destroy = 0x00f0a290;
project_dispatch_continue = 0x0164390c;
